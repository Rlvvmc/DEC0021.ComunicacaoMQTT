## mqttProj/build/Kconfig/arch/Kconfig
```kconfig
# Load Zephyr Arch Kconfig descriptions.
osource "/home/anderson/zephyrproject/zephyr/arch/rx/Kconfig"
osource "/home/anderson/zephyrproject/zephyr/arch/x86/Kconfig"
osource "/home/anderson/zephyrproject/zephyr/arch/xtensa/Kconfig"
osource "/home/anderson/zephyrproject/zephyr/arch/sparc/Kconfig"
osource "/home/anderson/zephyrproject/zephyr/arch/riscv/Kconfig"
osource "/home/anderson/zephyrproject/zephyr/arch/posix/Kconfig"
osource "/home/anderson/zephyrproject/zephyr/arch/openrisc/Kconfig"
osource "/home/anderson/zephyrproject/zephyr/arch/mips/Kconfig"
osource "/home/anderson/zephyrproject/zephyr/arch/arm64/Kconfig"
osource "/home/anderson/zephyrproject/zephyr/arch/arm/Kconfig"
osource "/home/anderson/zephyrproject/zephyr/arch/arc/Kconfig"
```

## mqttProj/build/Kconfig/boards/Kconfig.defconfig
```kconfig
# Load Zephyr board defconfig descriptions.
osource "/home/anderson/zephyrproject/zephyr/boards/espressif/esp32_devkitc/Kconfig.defconfig"
```

## mqttProj/build/Kconfig/boards/Kconfig.esp32_devkitc
```kconfig
# Load board Kconfig descriptions.
osource "/home/anderson/zephyrproject/zephyr/boards/espressif/esp32_devkitc/Kconfig.esp32_devkitc"
```

## mqttProj/build/Kconfig/boards/Kconfig.sysbuild
```kconfig
# Load Sysbuild board Kconfig descriptions.
osource "/home/anderson/zephyrproject/zephyr/boards/espressif/esp32_devkitc/Kconfig.sysbuild"
```
